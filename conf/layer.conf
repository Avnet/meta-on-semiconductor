## conf/layer.conf
```bitbake
# We have a conf and classes directory, add to BBPATH
BBPATH .= ":${LAYERDIR}"

# We have recipes-* directories, add to BBFILES
BBFILES += "${LAYERDIR}/recipes-*/*/*.bb \
	${LAYERDIR}/recipes-*/*/*.bbappend"

BBFILE_COLLECTIONS += "meta-on-semiconductor"
BBFILE_PATTERN_meta-on-semiconductor = "^${LAYERDIR}/"
BBFILE_PRIORITY_meta-on-semiconductor = "8"
LAYERSERIES_COMPAT_meta-on-semiconductor = "honister langdale"
```
